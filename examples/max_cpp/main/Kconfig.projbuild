## examples/max_cpp/main/Kconfig.projbuild
```kconfig
menu "max_cpp Example Configuration"
config ENV_GPIO_RANGE_MIN
    int
    default 0

config ENV_GPIO_RANGE_MAX
    int
    default 19
    # GPIOs 20/21 are always used by UART in examples

config ENV_GPIO_IN_RANGE_MAX
    int
    default ENV_GPIO_RANGE_MAX

config ENV_GPIO_OUT_RANGE_MAX
    int
    default ENV_GPIO_RANGE_MAX

config I2C_MASTER_SCL
    int "SCL GPIO Num"
    range ENV_GPIO_RANGE_MIN ENV_GPIO_OUT_RANGE_MAX
    default 4
    help
        GPIO number for I2C Master clock line.

config I2C_MASTER_SDA
    int "SDA GPIO Num"
    range ENV_GPIO_RANGE_MIN ENV_GPIO_OUT_RANGE_MAX
    default 5
    help
        GPIO number for I2C Master data line.

config I2C_MASTER_FREQUENCY
    int "Master Frequency"
    default 400000
    help
        I2C Speed of Master device.

endmenu
```
